#include "fft.h"
#include <cmath>
#include <cstdint>
#include <cstdio>

#ifndef SIMULATION
#include "pico/stdlib.h"
#endif

static const uint16_t max_m = 8; // the largest size of FFT supported
static const uint16_t max_n_over_2 = 1 << (max_m - 1);
static int16_t fixed_cos_table[max_n_over_2];
static int16_t fixed_sin_table[max_n_over_2];
static const uint8_t fraction_bits = 14;
static const int16_t K  =  (1 << (fraction_bits - 1));

int16_t float2fixed(float float_value) {
        return round(float_value * (1 << fraction_bits));
}
int16_t product(int16_t a, int16_t b) {
        return ((static_cast<int32_t>(b) * a)+K) >> fraction_bits;
}

void fft_initialise() {
  for (int i = 0; i < max_n_over_2; ++i) {
    fixed_cos_table[i] = float2fixed(cosf((float)i * M_PI / max_n_over_2));
    fixed_sin_table[i] = float2fixed(sinf((float)i * M_PI / max_n_over_2));
  }
}

#ifndef SIMULATION
unsigned __not_in_flash_func(bit_reverse)(unsigned x, unsigned m) {
#else
unsigned bit_reverse(unsigned x, unsigned m) {
#endif
    static const unsigned char lookup[] = {
        0x00, 0x80, 0x40, 0xc0, 0x20, 0xa0, 0x60, 0xe0,
        0x10, 0x90, 0x50, 0xd0, 0x30, 0xb0, 0x70, 0xf0,
        0x08, 0x88, 0x48, 0xc8, 0x28, 0xa8, 0x68, 0xe8,
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        0x1f, 0x9f, 0x5f, 0xdf, 0x3f, 0xbf, 0x7f, 0xff,
  };
  x = (lookup[x&0xff] << 8) | lookup[x>>8];
  return x >> (16-m);
}

#ifndef SIMULATION
void __not_in_flash_func(fixed_fft)(int16_t reals[], int16_t imaginaries[], unsigned m, bool scale) {
#else
void fixed_fft(int16_t reals[], int16_t imaginaries[], unsigned m, bool scale) {
#endif
  uint16_t stage, subdft_size, span, j, i, ip;
  int16_t temp_real, temp_imaginary;
  int16_t imaginary_twiddle, real_twiddle;
  const unsigned n = 1 << m;

  // bit reverse data
  for (i = 0u; i < n; i++) {
    ip = bit_reverse(i, m);
    if (i < ip) {
      temp_real = reals[i];
      temp_imaginary = imaginaries[i];
      reals[i] = reals[ip];
      imaginaries[i] = imaginaries[ip];
      reals[ip] = temp_real;
      imaginaries[ip] = temp_imaginary;
    }
  }

  // butterfly multiplies
  for (stage = 0; stage < m; stage++) {
    subdft_size = 2 << stage;
    span = subdft_size >> 1;

    for (j = 0; j < span; j++) {
      for (i = j; i < n; i += subdft_size) {
        ip = i + span;

        real_twiddle = fixed_cos_table[j << (max_m - stage - 1)];
        imaginary_twiddle = -fixed_sin_table[j << (max_m - stage - 1)];

        temp_real = product(reals[ip], real_twiddle) -
                    product(imaginaries[ip], imaginary_twiddle);
        temp_imaginary = product(reals[ip], imaginary_twiddle) +
                         product(imaginaries[ip], real_twiddle);

        reals[ip] = reals[i] - temp_real;
        imaginaries[ip] = imaginaries[i] - temp_imaginary;

        reals[i] = reals[i] + temp_real;
        imaginaries[i] = imaginaries[i] + temp_imaginary;

        // after every second stage lose 1 bit
        if (stage & 1) {
          reals[ip] = reals[ip]/2;
          imaginaries[ip] = imaginaries[ip]/2;
          reals[i] = reals[i]/2;
          imaginaries[i] = imaginaries[i]/2;
        }
      }
    }
  }
}

#ifndef SIMULATION
void __not_in_flash_func(fixed_ifft)(int16_t reals[], int16_t imaginaries[], unsigned m) {
#else
void fixed_ifft(int16_t reals[], int16_t imaginaries[], unsigned m) {
#endif
  fixed_fft(imaginaries, reals, m, true);
}
